# ESP32-C3 register map
Vendor: ESPRESSIF SYSTEMS (SHANGHAI) CO., LTD.; Series: ESP32-C3; File version: 10
32-bit RISC-V MCU & 2.4 GHz Wi-Fi & Bluetooth 5 (LE)
CPU: RV32IMC r0p0, little endian, no MPU, no FPU, 4 interrupt priority bits
Address unit: 32 bits
Registers are 32-bit, read-write, reset 0x0 unless marked. A register's access mark holds for its fields unless they carry their own. Offsets are from the block's base; lines under a group give offsets from that group; [hi:lo] are bit positions; {n}, {i} and the like mark numbered series; 'fields as' and 'values as' point back to an identical list; <NAME> marks a mode.

## Memory map
0x60000000 UART0 size 0x84 — UART (Universal Asynchronous Receiver-Transmitter) Controller
0x60002000 SPI1 size 0xA8 — SPI (Serial Peripheral Interface) Controller
0x60003000 SPI0 size 0x48 — SPI (Serial Peripheral Interface) Controller
0x60004000 GPIO size 0x31C — General Purpose Input/Output
0x60004F00 GPIOSD size 0x1C — Sigma-Delta Modulation
0x60008000 RTC_CNTL size 0x12C — Real-Time Clock Control
0x60008800 EFUSE size 0x1CC — eFuse Controller
0x60009000 IO_MUX size 0x60 — Input/Output Multiplexer
0x6000C000 UHCI1 size 0x84 — Universal Host Controller Interface
0x60010000 UART1 size 0x84 — UART (Universal Asynchronous Receiver-Transmitter) Controller
0x60013000 I2C0 size 0x90 — I2C (Inter-Integrated Circuit) Controller
0x60014000 UHCI0 size 0x84 — Universal Host Controller Interface
0x60016000 RMT size 0x78 — Remote Control Peripheral
0x60016000 SPI2 size 0x94 — SPI (Serial Peripheral Interface) Controller
0x60019000 LEDC size 0xB0 — LED Control PWM (Pulse Width Modulation)
0x6001F000 TIMG0 size 0x68 — Timer Group
0x60020000 TIMG1 size 0x68 — Timer Group
0x60023000 SYSTIMER size 0x78 — System Timer
0x60026000 APB_CTRL size 0xA0 — Advanced Peripheral Bus Controller
0x60026000 RNG size 0x4 — Hardware random number generator
0x6002B000 TWAI size 0x6C — Two-Wire Automotive Interface
0x6002D000 I2S size 0x5C — I2S (Inter-IC Sound) Controller
0x6003A000 AES size 0xBC — AES (Advanced Encryption Standard) Accelerator
0x6003B000 SHA size 0xB0 — SHA (Secure Hash Algorithm) Accelerator
0x6003C000 RSA size 0x74 — RSA (Rivest Shamir Adleman) Accelerator
0x6003D000 DS size 0x108C — Digital Signature
0x6003E000 HMAC size 0xA4 — HMAC (Hash-based Message Authentication Code) Accelerator
0x6003F000 DMA size 0x174 — DMA (Direct Memory Access) Controller
0x60040000 APB_SARADC size 0x68 — Successive Approximation Register Analog to Digital Converter
0x60043000 USB_DEVICE size 0x50 — Full-speed USB Serial/JTAG Controller
0x600C0000 SYSTEM size 0xA0
0x600C1000 SENSITIVE size 0x178
0x600C2000 INTERRUPT_CORE0 size 0x19C — Interrupt Core
0x600C4000 EXTMEM size 0x108 — External Memory
0x600CC000 XTS_AES size 0x30 — XTS-AES-128 Flash Encryption
0x600CE000 ASSIST_DEBUG size 0xA0 — Debug Assist

## Interrupts
0 WIFI_MAC (INTERRUPT_CORE0)
1 WIFI_MAC_NMI (INTERRUPT_CORE0)
2 WIFI_PWR (INTERRUPT_CORE0)
3 WIFI_BB (INTERRUPT_CORE0)
4 BT_MAC (INTERRUPT_CORE0)
5 BT_BB (INTERRUPT_CORE0)
6 BT_BB_NMI (INTERRUPT_CORE0)
7 RWBT (INTERRUPT_CORE0)
8 RWBLE (INTERRUPT_CORE0)
9 RWBT_NMI (INTERRUPT_CORE0)
10 RWBLE_NMI (INTERRUPT_CORE0)
15 UHCI0
16 GPIO
17 GPIO_NMI (GPIO)
19 SPI2
20 I2S
21 UART0
22 UART1
23 LEDC
24 EFUSE
25 TWAI
26 USB_SERIAL_JTAG (USB_DEVICE)
27 RTC_CORE (RTC_CNTL)
28 RMT
29 I2C_EXT0 (I2C0)
32 TG0_T0_LEVEL (TIMG0)
33 TG0_WDT_LEVEL (TIMG0)
34 TG1_T0_LEVEL (TIMG1)
35 TG1_WDT_LEVEL (TIMG1)
37 SYSTIMER_TARGET0 (SYSTIMER)
38 SYSTIMER_TARGET1 (SYSTIMER)
39 SYSTIMER_TARGET2 (SYSTIMER)
43 APB_ADC (APB_SARADC)
44 DMA_CH0 (DMA)
45 DMA_CH1 (DMA)
46 DMA_CH2 (DMA)
47 RSA
48 AES
49 SHA
50 SW_INTR_0 (INTERRUPT_CORE0)
51 SW_INTR_1 (INTERRUPT_CORE0)
52 SW_INTR_2 (INTERRUPT_CORE0)
53 SW_INTR_3 (INTERRUPT_CORE0)
54 ASSIST_DEBUG

## Licence text in the file
Copyright 2022 Espressif Systems (Shanghai) PTE LTD Licensed under the Apache License, Version 2.0 (the "License"); you may not use this file except in compliance with the License. You may obtain a copy of the License at http://www.apache.org/licenses/LICENSE-2.0 Unless required by applicable law or agreed to in writing, software distributed under the License is distributed on an "AS IS" BASIS, WITHOUT WARRANTIES OR CONDITIONS OF ANY KIND, either express or implied. See the License for the specific language governing permissions and limitations under the License.
